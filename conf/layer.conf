## conf/layer.conf
```bitbake
# We have a conf and classes directory, add to BBPATH
BBPATH .= ":${LAYERDIR}"

# We have recipes-* directories, add to BBFILES
BBFILES += "${LAYERDIR}/recipes-*/*/*.bb ${LAYERDIR}/recipes-*/*/*.bbappend"

BBFILE_COLLECTIONS += "accelize"
BBFILE_PATTERN_accelize = "^${LAYERDIR}/"
BBFILE_PRIORITY_accelize = "1"

# This should only be incremented on significant changes that will
# cause compatibility issues with other layers
LAYERVERSION_accelize = "1"

LAYERDEPENDS_accelize = "core provenrun"

LAYERSERIES_COMPAT_accelize = "honister"
```
